/ {
   valve {
      //compatible = "gpio-leds"; // HACK
      compatible = "steinel,valve";

      port017: p017 {
         label = "Valve auf";
         gpios = <&gpio0 17 GPIO_ACTIVE_LOW>;
      };
   };

   aliases {
      valve1 = &port017; 
   };
};


